/**
 ******************************************************************************
 *  oled.c —— SSD1306 OLED 驱动（128×64，I2C，6×8 字体）
 ******************************************************************************
 *  原理：
 *      屏幕分成 8 个 page，每个 page 高 8 像素、宽 128 像素
 *      显存 1024 字节（128 × 64 / 8）
 *      程序改的是本地缓冲区，调 oled_refresh() 才真正写到屏幕
 ******************************************************************************
 */
#include "oled.h"
#include "i2c.h"
#include <stdarg.h>

/* ★★★ 2026-10-06 新增：中文字库（16×16 点阵，由 generate_cnfont.py 生成）
 * 直接 #include 数据头文件，这样只要用 oled.c 就自动有中文显示能力，
 * 不用每个工程都去加 cnfont.c。 */
#include "cnfont_data.h"

/* 显存缓冲区：128 列 × 8 页 */
static uint8_t gram[8][128];

/* ==================== 6×8 ASCII 字体（0x20 ~ 0x7F） ==================== */
static const uint8_t F6x8[][6] = {
    {0x00,0x00,0x00,0x00,0x00,0x00}, /* ' ' */
    {0x00,0x00,0x5F,0x00,0x00,0x00}, /* ! */
    {0x00,0x07,0x00,0x07,0x00,0x00}, /* " */
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    {0x08,0x08,0x2A,0x1C,0x08,0x00}, /* ~ */
};

/* ==================== 底层：写命令 / 写数据 ==================== */

static void oled_cmd(uint8_t c)
{
    i2c_write_regs(OLED_ADDR, 0x00, &c, 1);     /* 0x00 = 命令 */
}

static void oled_data(const uint8_t *d, uint16_t len)
{
    i2c_write_regs(OLED_ADDR, 0x40, d, len);    /* 0x40 = 数据 */
}

/* ==================== 初始化 ==================== */

void oled_init(void)
{
    delay_ms(50);

    oled_cmd(0xAE);     /* 关显示 */
    oled_cmd(0x20);     /* 内存寻址模式 */
    /* ★★★ 2026-10-15 修复：0x10 不是合法的寻址模式参数
     *   （合法值只有 0x00 水平 / 0x01 垂直 / 0x02 页寻址），
     *   芯片会忽略，注释说的"页寻址"其实没生效 —— 目前不出问题是因为
     *   每次刷新前都显式重设了页/列地址。*/
    oled_cmd(0x02);     /* 页寻址模式 */
    oled_cmd(0xB0);     /* 页起始地址 */
    oled_cmd(0xC8);     /* COM 输出扫描方向（上下翻转） */
    oled_cmd(0x00);
    oled_cmd(0x10);
    oled_cmd(0x40);     /* 起始行 */
    oled_cmd(0x81);     /* 对比度 */
    oled_cmd(0xFF);
    oled_cmd(0xA1);     /* 段重映射（左右翻转） */
    oled_cmd(0xA6);     /* 正常显示（非反色） */
    oled_cmd(0xA8);     /* 多路复用比 */
    oled_cmd(0x3F);
    oled_cmd(0xA4);     /* 输出跟随 RAM */
    oled_cmd(0xD3);     /* 显示偏移 */
    oled_cmd(0x00);
    oled_cmd(0xD5);     /* 时钟分频 */
    oled_cmd(0xF0);
    oled_cmd(0xD9);     /* 预充电周期 */
    oled_cmd(0x22);
    oled_cmd(0xDA);     /* COM 硬件配置 */
    oled_cmd(0x12);
    oled_cmd(0xDB);     /* VCOMH */
    oled_cmd(0x20);
    oled_cmd(0x8D);     /* 电荷泵 */
    oled_cmd(0x14);     /* ★ 开启（不开的话屏幕不亮） */
    oled_cmd(0xAF);     /* 开显示 */

    oled_clear();
    oled_refresh();
}

/* ==================== ★ 中文显示（16×16 点阵） ==================== */

/**
 * 在字库里找一个 UTF-8 汉字（★ 按 3 字节比较，不能按单字节！）
 * 返回索引，0xFF = 没找到
 */
static uint8_t cn_find(const char *s)
{
    uint8_t i;
    for (i = 0; i < CN_COUNT; i++) {
        if ((uint8_t)cn_chars[i * 3]     == (uint8_t)s[0] &&
            (uint8_t)cn_chars[i * 3 + 1] == (uint8_t)s[1] &&
            (uint8_t)cn_chars[i * 3 + 2] == (uint8_t)s[2]) {
            return i;
        }
    }
    return 0xFF;
}

/**
 * ★ 显示中文（16×16 点阵，每个字占 16 列 × 2 页）
 *   x    : 起始列（0 ~ 112）
 *   page : 起始页（0 ~ 6，因为要占 2 页）
 *   s    : UTF-8 中文字符串
 *
 * ★ 注意：屏幕只有 8 页，所以中文最多显示 4 行。
 * ★ 字库里没有的字会被跳过（不显示）。
 */
void oled_draw_cn(uint8_t x, uint8_t page, const char *s)
{
    uint8_t i;

    if (page > 6) return;

    /* ★ 关键：UTF-8 汉字占 3 字节，必须一次跳 3 字节，
       否则会把一个汉字拆成 3 个字节分别去查字库 → 显示错乱 */
    while (s[0] && s[1] && s[2]) {
        uint8_t idx = cn_find(s);

        if (x + 16 > 128) break;

        if (idx != 0xFF) {
            for (i = 0; i < 16; i++) {
                gram[page][x + i]         = cn_data[idx][i];        /* 上半页 */
                gram[page + 1][x + i]     = cn_data[idx][16 + i];   /* 下半页 */
            }
        }
        x += 16;
        s += 3;
    }
}

/* ==================== 缓冲区操作 ==================== */

void oled_clear(void)
{
    memset(gram, 0x00, sizeof(gram));
}

void oled_refresh(void)
{
    uint8_t page;

    for (page = 0; page < 8; page++) {
        oled_cmd(0xB0 + page);      /* 设置页地址 */
        oled_cmd(0x00);             /* 列低 4 位 */
        oled_cmd(0x10);             /* 列高 4 位 */
        oled_data(gram[page], 128);
    }
}

void oled_rect_clear(uint8_t x, uint8_t page, uint8_t w, uint8_t pages)
{
    uint8_t p, i;
    for (p = page; p < page + pages && p < 8; p++) {
        for (i = x; i < x + w && i < 128; i++) {
            gram[p][i] = 0x00;
        }
    }
}

/**
 * ★★★ 2026-10-06 新增：只刷新一页（分帧刷新用）
 *
 * 【为什么需要】
 *   软件 I2C 只有 25kHz，整屏 1024 字节刷一遍要约 374 毫秒。
 *   在这 374ms 里主循环完全卡住，MAX30102 的 FIFO 会积压样本，
 *   一旦溢出就丢数据，心率算法的时间基准会错乱 → 心率永远算不出来。
 *
 *   改成一页一页刷：每页只有 3 条命令 + 128 字节 ≈ 46ms，
 *   主循环每次都只阻塞 46ms，不会让 FIFO 溢出。
 *
 * 用法：主循环里轮着调 oled_refresh_page(0) ~ oled_refresh_page(7)，
 *       8 次刷完一整屏。
 */
void oled_refresh_page(uint8_t page)
{
    if (page > 7) return;

    oled_cmd((uint8_t)(0xB0 + page));      /* 页地址 */
    oled_cmd(0x00);                        /* 列低 4 位 */
    oled_cmd(0x10);                        /* 列高 4 位 */
    oled_data(gram[page], 128);
}

/* ==================== 字符显示 ==================== */

void oled_draw_str(uint8_t x, uint8_t page, const char *s)
{
    uint8_t i;

    if (page > 7) return;

    while (*s) {
        uint8_t ch = (uint8_t)(*s++);

        if (ch < 0x20 || ch > 0x7E) ch = 0x20;      /* 非可打印字符显示空格 */

        if (x + 6 > 128) break;

        for (i = 0; i < 6; i++) {
            gram[page][x + i] = F6x8[ch - 0x20][i];
        }
        x += 6;
    }
}

void oled_draw_num(uint8_t x, uint8_t page, int32_t num)
{
    char buf[16];
    sprintf(buf, "%d", (int)num);
    oled_draw_str(x, page, buf);
}

void oled_printf(uint8_t x, uint8_t page, const char *fmt, ...)
{
    char buf[64];
    va_list ap;

    va_start(ap, fmt);
    vsnprintf(buf, sizeof(buf), fmt, ap);
    va_end(ap);

    oled_draw_str(x, page, buf);
}
