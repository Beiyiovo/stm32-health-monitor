/**
 ******************************************************************************
 *  19_oled_cn —— ★ OLED 中文显示测试
 ******************************************************************************
 *  目的：
 *      让 OLED 显示中文（16×16 点阵）
 *
 *  ★ 字库来源：_common/cnfont.c（由 Python 脚本从 Windows 字体生成）
 *      当前字库包含这些字：欣 你 在 干 什 么 我 好 想
 *      ★ 想显示别的字，改 generate_cnfont.py 里的 TEXT 再跑一次
 *
 *  ★ 显示效果（循环）：
 *      ① 英文标题
 *      ② 中文两行：「欣欣你在干什么」「我好想你」
 *      ③ 中文 + 滚动
 *      ④ 回到 ①
 *
 *  接线：
 *      OLED GND → STM32【G】
 *      OLED VCC → STM32【3.3】
 *      OLED SCL → STM32【B6】
 *      OLED SDA → STM32【B7】
 *      ★ 两个 4.7kΩ：B6←→3.3、B7←→3.3
 *      USB-TTL：TXD→A10、RXD→A9、GND→G
 ******************************************************************************
 */
#include "bsp.h"
#include "i2c.h"
#include "cnfont.h"

#define OLED_ADDR   0x3C
#define W           128
#define PAGES       8

static uint8_t gram[PAGES][W];
static uint32_t g_err = 0;

/* ==================== 底层 ==================== */

static uint8_t oled_cmd(uint8_t c)
{
    return i2c_write_regs(OLED_ADDR, 0x00, &c, 1);
}

static uint8_t oled_data(const uint8_t *d, uint16_t len)
{
    return i2c_write_regs(OLED_ADDR, 0x40, d, len);
}

static uint8_t oled_refresh(void)
{
    uint8_t page, fails = 0;
    for (page = 0; page < PAGES; page++) {
        if (oled_cmd((uint8_t)(0xB0 + page)) != I2C_OK) { fails++; continue; }
        if (oled_cmd(0x00) != I2C_OK) { fails++; continue; }
        if (oled_cmd(0x10) != I2C_OK) { fails++; continue; }
        if (oled_data(gram[page], W) != I2C_OK) { fails++; }
    }
    g_err += fails;
    return fails;
}

static uint8_t oled_init_seq(void)
{
    uint8_t fail = 0;
    static const uint8_t seq[] = {
        0xAE, 0x20, 0x10, 0xB0, 0xC8, 0x00, 0x10, 0x40,
        0x81, 0xFF, 0xA1, 0xA6, 0xA8, 0x3F, 0xA4, 0xD3,
        0x00, 0xD5, 0xF0, 0xD9, 0x22, 0xDA, 0x12, 0xDB,
        0x20, 0x8D, 0x14, 0xAF
    };
    uint8_t i;
    for (i = 0; i < sizeof(seq); i++) {
        if (oled_cmd(seq[i]) != I2C_OK) fail++;
        delay_ms(2);
    }
    return fail;
}

/* ==================== 6×8 英文 ==================== */
static const uint8_t F6x8[][6] = {
    {0x00,0x00,0x00,0x00,0x00,0x00},{0x00,0x00,0x5F,0x00,0x00,0x00},
    {0x00,0x07,0x00,0x07,0x00,0x00},{0x14,0x7F,0x14,0x7F,0x14,0x00},
    {0x24,0x2A,0x7F,0x2A,0x12,0x00},{0x23,0x13,0x08,0x64,0x62,0x00},
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    {0x08,0x08,0x2A,0x1C,0x08,0x00},
};

static void clear(void) { memset(gram, 0, sizeof(gram)); }

static void putstr(uint8_t x, uint8_t page, const char *s)
{
    if (page >= PAGES) return;
    while (*s) {
        uint8_t ch = (uint8_t)(*s++);
        uint8_t i;
        if (ch < 0x20 || ch > 0x7E) ch = 0x20;
        if (x + 6 > W) break;
        for (i = 0; i < 6; i++) gram[page][x + i] = F6x8[ch - 0x20][i];
        x += 6;
    }
}

static void putnum(uint8_t x, uint8_t page, int32_t v)
{
    char b[16];
    sprintf(b, "%d", (int)v);
    putstr(x, page, b);
}

/* ==================== ★ 中文显示 ==================== */

/* 在字库里找这个汉字，返回索引；找不到返回 0xFF */
static uint8_t find_cn(char c)
{
    uint8_t i;
    for (i = 0; i < cnfont_count; i++) {
        if (cnfont_chars[i] == c) return i;
    }
    return 0xFF;
}

/**
 * 显示中文（16×16 点阵，每个字占 16 列 × 2 页）
 * x    : 起始列（0~112）
 * page : 起始页（0~6，因为要占 2 页）
 */
static void draw_cn(uint8_t x, uint8_t page, const char *s)
{
    uint8_t i;

    if (page > 6) return;

    while (*s) {
        uint8_t idx = find_cn(*s);

        if (x + 16 > W) break;

        if (idx != 0xFF) {
            for (i = 0; i < 16; i++) {
                gram[page][x + i]         = cnfont_data[idx][i];        /* 上半 */
                gram[page + 1][x + i]     = cnfont_data[idx][16 + i];   /* 下半 */
            }
        }
        x += 16;
        s++;
    }
}

/* ==================== 主程序 ==================== */

int main(void)
{
    uint32_t n = 1;
    uint8_t  i, fails;

    bsp_init();
    uart1_init();
    i2c_init();

    printf("\r\n\r\n");
    printf("============================================\r\n");
    printf("  501 毕设 —— OLED 中文显示测试\r\n");
    printf("============================================\r\n");
    printf("  字库里有 %u 个汉字: %s\r\n", cnfont_count, cnfont_chars);
    printf("============================================\r\n\r\n");

    printf("【探测】");
    if (i2c_probe(OLED_ADDR) == I2C_OK) printf(" 找到 OLED\r\n");
    else                                 printf(" X 找不到 OLED\r\n");

    printf("【初始化】... ");
    fails = oled_init_seq();
    printf("%s\r\n\r\n", fails ? "★ 有失败" : "√");

    delay_ms(300);

    while (1) {
        printf("\r\n████ 第 %u 轮 ████\r\n", (unsigned)n);

        /* ===== ① 英文标题 ===== */
        printf("  【①】英文标题... ");
        clear();
        putstr(0, 0, "  STM32 Health Helper");
        putstr(0, 2, "  Chinese Display Test");
        putstr(0, 4, "  Font: SimHei 16x16");
        putstr(0, 6, "  Chars loaded: ");
        putnum(90, 6, (int32_t)cnfont_count);
        fails = oled_refresh();
        printf("%s\r\n", fails ? "★ 失败" : "√");
        delay_ms(2000);

        /* ===== ② 中文两行（★ 主角） ===== */
        printf("  【②】中文显示... ");
        clear();
        /* 「欣欣你在干什么」 7 个字 × 16 = 112 列，居中偏左 */
        draw_cn(8, 0, "欣欣你在干什么");
        /* 「我好想你」 4 个字 × 16 = 64 列，居中 */
        draw_cn(32, 3, "我好想你");
        putstr(20, 7, ">_<  ~");
        fails = oled_refresh();
        printf("%s\r\n", fails ? "★ 失败" : "√");
        delay_ms(4000);

        /* ===== ③ 中文 + 动态数字 ===== */
        printf("  【③】中文 + 计数器... ");
        clear();
        draw_cn(0, 0, "欣欣你在干什么");
        putstr(0, 3, "Count:");
        putstr(0, 5, "I2C err:");
        fails = oled_refresh();
        printf("%s\r\n", fails ? "★ 失败" : "√");

        for (i = 1; i <= 8; i++) {
            /* 只清数字区域 */
            memset(&gram[3][48], 0, 24);
            memset(&gram[5][60], 0, 24);
            putnum(48, 3, (int32_t)i);
            putnum(60, 5, (int32_t)g_err);
            oled_refresh();
            printf("      计数 = %u\r\n", i);
            delay_ms(600);
        }

        /* ===== ④ 中文滚动 ===== */
        printf("  【④】中文横向滚动... ");
        {
            int16_t off;
            /* 把「我好想你」放在一个宽的虚拟画布上滚动 */
            for (off = 0; off < 5; off++) {
                clear();
                draw_cn((uint8_t)(off * 24), 2, "我好想你");
                oled_refresh();
                delay_ms(180);
            }
            for (off = 4; off >= 0; off--) {
                clear();
                draw_cn((uint8_t)(off * 24), 2, "我好想你");
                oled_refresh();
                delay_ms(180);
            }
        }
        printf("√\r\n");

        /* ===== ⑤ 统计 ===== */
        printf("  【⑤】统计... ");
        clear();
        draw_cn(16, 0, "我好想你");
        putstr(0, 3, "Refresh OK");
        putstr(0, 5, "I2C errors:");
        putnum(78, 5, (int32_t)g_err);
        putstr(0, 7, g_err == 0 ? "STATUS: PERFECT" : "STATUS: HAS ERR");
        fails = oled_refresh();
        printf("%s\r\n", fails ? "★ 失败" : "√");
        delay_ms(3000);

        n++;
        if (n > 999) n = 1;
    }
}
