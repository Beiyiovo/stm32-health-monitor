/**
 ******************************************************************************
 *  20_all_scan —— ★★★ 三模块一起扫描 + OLED 中文显示
 ******************************************************************************
 *  功能：
 *      ① 扫描 I2C 总线，列出所有在线设备
 *      ② 在 OLED 上显示扫描结果（英文）
 *      ③ 在 OLED 上显示中文「冻冻我想你了」
 *      ④ 循环
 *
 *  ★★ 中文显示的 bug 已修：
 *      之前 draw_cn() 里 s++ 每次只前进 1 字节，但 UTF-8 汉字占 3 字节，
 *      导致把一个汉字拆成 3 个字节分别查字库 → 只显示前一两个字。
 *      现在改成：一次跳 3 字节，并按 3 字节比较。
 *
 *  ★★★ 接线（三个模块【并联】在同一组 I2C 总线上）：
 *
 *      OLED 模块：
 *          GND → STM32 下排【G】
 *          VCC → STM32 上排【3.3】
 *          SCL → STM32 下排【B6】
 *          SDA → STM32 下排【B7】
 *
 *      MPU6050 模块（8 脚）：
 *          VCC → STM32【3.3】
 *          GND → STM32【G】
 *          SCL → STM32【B6】
 *          SDA → STM32【B7】
 *          ★ AD0 → STM32【G】      ← 必须！否则地址变 0x69
 *          XDA / XCL / INT → 空着不接
 *
 *      MAX30102 模块（★ 用下排 4 个脚，上排全不接）：
 *          VIN → STM32【3.3】
 *          SDA → STM32【B7】       ← ★ 注意 SDA 在 SCL 前面
 *          SCL → STM32【B6】
 *          GND → STM32【G】
 *
 *      ★ 两个 4.7kΩ 上拉（必须）：
 *          电阻#1：STM32 的【B6】针 ←→【3.3】针
 *          电阻#2：STM32 的【B7】针 ←→【3.3】针
 *
 *      USB-TTL（烧录 + 看打印）：
 *          TXD → STM32【A10】
 *          RXD → STM32【A9】
 *          GND → STM32【G】
 ******************************************************************************
 */
#include "bsp.h"
#include "i2c.h"
#include "cnfont.h"

#define OLED_ADDR   0x3C
#define W           128
#define PAGES       8

static uint8_t gram[PAGES][W];
static uint32_t g_err = 0;

/* ==================== OLED 底层 ==================== */

static uint8_t oled_cmd(uint8_t c)
{
    return i2c_write_regs(OLED_ADDR, 0x00, &c, 1);
}

static uint8_t oled_data(const uint8_t *d, uint16_t len)
{
    return i2c_write_regs(OLED_ADDR, 0x40, d, len);
}

static uint8_t oled_refresh(void)
{
    uint8_t page, fails = 0;
    for (page = 0; page < PAGES; page++) {
        if (oled_cmd((uint8_t)(0xB0 + page)) != I2C_OK) { fails++; continue; }
        if (oled_cmd(0x00) != I2C_OK) { fails++; continue; }
        if (oled_cmd(0x10) != I2C_OK) { fails++; continue; }
        if (oled_data(gram[page], W) != I2C_OK) { fails++; }
    }
    g_err += fails;
    return fails;
}

static uint8_t oled_init_seq(void)
{
    uint8_t fail = 0;
    static const uint8_t seq[] = {
        0xAE, 0x20, 0x10, 0xB0, 0xC8, 0x00, 0x10, 0x40,
        0x81, 0xFF, 0xA1, 0xA6, 0xA8, 0x3F, 0xA4, 0xD3,
        0x00, 0xD5, 0xF0, 0xD9, 0x22, 0xDA, 0x12, 0xDB,
        0x20, 0x8D, 0x14, 0xAF
    };
    uint8_t i;
    for (i = 0; i < sizeof(seq); i++) {
        if (oled_cmd(seq[i]) != I2C_OK) fail++;
        delay_ms(2);
    }
    return fail;
}

/* ==================== 6×8 英文 ==================== */
static const uint8_t F6x8[][6] = {
    {0x00,0x00,0x00,0x00,0x00,0x00},{0x00,0x00,0x5F,0x00,0x00,0x00},
    {0x00,0x07,0x00,0x07,0x00,0x00},{0x14,0x7F,0x14,0x7F,0x14,0x00},
    {0x24,0x2A,0x7F,0x2A,0x12,0x00},{0x23,0x13,0x08,0x64,0x62,0x00},
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    {0x08,0x08,0x2A,0x1C,0x08,0x00},
};

static void clear(void) { memset(gram, 0, sizeof(gram)); }

static void putstr(uint8_t x, uint8_t page, const char *s)
{
    if (page >= PAGES) return;
    while (*s) {
        uint8_t ch = (uint8_t)(*s++);
        uint8_t i;
        if (ch < 0x20 || ch > 0x7E) ch = 0x20;
        if (x + 6 > W) break;
        for (i = 0; i < 6; i++) gram[page][x + i] = F6x8[ch - 0x20][i];
        x += 6;
    }
}

static void putnum(uint8_t x, uint8_t page, int32_t v)
{
    char b[16];
    sprintf(b, "%d", (int)v);
    putstr(x, page, b);
}

/* ==================== ★ 中文（已修 UTF-8 bug） ==================== */

/**
 * 在字库里找一个 UTF-8 汉字（★ 按 3 字节比较）
 * 返回索引，0xFF = 没找到
 */
static uint8_t find_cn_utf8(const char *s)
{
    uint8_t i;
    for (i = 0; i < cnfont_count; i++) {
        if ((uint8_t)cnfont_chars[i * 3]     == (uint8_t)s[0] &&
            (uint8_t)cnfont_chars[i * 3 + 1] == (uint8_t)s[1] &&
            (uint8_t)cnfont_chars[i * 3 + 2] == (uint8_t)s[2]) {
            return i;
        }
    }
    return 0xFF;
}

/**
 * ★ 修正版：显示中文（16×16，每个字占 16 列 × 2 页）
 * ★ 关键修复：s += 3（UTF-8 汉字占 3 字节），而不是 s++
 */
static void draw_cn(uint8_t x, uint8_t page, const char *s)
{
    uint8_t i;

    if (page > 6) return;

    while (s[0] && s[1] && s[2]) {              /* 还剩至少 3 字节 */
        uint8_t idx = find_cn_utf8(s);

        if (x + 16 > W) break;

        if (idx != 0xFF) {
            for (i = 0; i < 16; i++) {
                gram[page][x + i]         = cnfont_data[idx][i];        /* 上半 */
                gram[page + 1][x + i]     = cnfont_data[idx][16 + i];   /* 下半 */
            }
        }
        x += 16;
        s += 3;                                  /* ★★★ 关键修复 */
    }
}

/* ==================== 扫描 ==================== */

static const char *dev_name(uint8_t a)
{
    switch (a) {
        case 0x3C: case 0x3D: return "OLED";
        case 0x57:            return "MAX30102";
        case 0x68: case 0x69: return "MPU6050";
        case 0x76:            return "BMP280";
        case 0x1E:            return "HMC5883";
        default:              return "Unknown";
    }
}

/* ==================== 主程序 ==================== */

int main(void)
{
    uint8_t  found[16];
    uint8_t  n;
    uint8_t  addr;
    uint32_t round = 1;
    uint8_t  fails, i;
    int      has_oled, has_max, has_mpu;

    bsp_init();
    uart1_init();
    i2c_init();

    printf("\r\n\r\n");
    printf("============================================\r\n");
    printf("  501 毕设 —— 三模块扫描 + OLED 中文显示\r\n");
    printf("============================================\r\n");
    printf("  接线：三个模块并联在 B6(SCL)/B7(SDA) 上\r\n");
    printf("        ★ 两个 4.7kΩ 上拉：B6<->3.3、B7<->3.3\r\n");
    printf("        ★ MPU6050 的 AD0 必须接 GND\r\n");
    printf("        ★ MAX30102 脚序 VIN·SDA·SCL·GND\r\n");
    printf("============================================\r\n\r\n");

    printf("【OLED 初始化】... ");
    fails = oled_init_seq();
    printf("%s\r\n\r\n", fails ? "★ 有失败" : "√");

    /* 启动画面 */
    clear();
    putstr(16, 2, "STM32 Health");
    putstr(16, 4, "Helper  v1.0");
    oled_refresh();
    delay_ms(1200);

    while (1) {
        printf("\r\n██████████ 第 %u 轮扫描 ██████████\r\n", (unsigned)round);

        /* ===== 扫描 ===== */
        n = 0;
        for (addr = 0x01; addr < 0x80; addr++) {
            if (i2c_probe(addr) == I2C_OK) {
                printf("  发现设备: 0x%02X  (%s)\r\n", addr, dev_name(addr));
                if (n < sizeof(found)) found[n++] = addr;
            }
        }
        printf("  共发现 %u 个设备\r\n", n);

        has_oled = (i2c_probe(0x3C) == I2C_OK || i2c_probe(0x3D) == I2C_OK);
        has_max  = (i2c_probe(0x57) == I2C_OK);
        has_mpu  = (i2c_probe(0x68) == I2C_OK || i2c_probe(0x69) == I2C_OK);

        printf("  [%s] OLED      (0x3C)\r\n", has_oled ? "√" : "X");
        printf("  [%s] MAX30102  (0x57)\r\n", has_max  ? "√" : "X");
        printf("  [%s] MPU6050   (0x68)\r\n", has_mpu  ? "√" : "X");
        printf("\r\n");

        /* ===== OLED 显示扫描结果 ===== */
        clear();
        putstr(0, 0, "=== I2C SCAN ===");
        putstr(0, 1, "Found:");
        putnum(48, 1, (int32_t)n);

        /* 列出每个设备的地址和名字 */
        for (i = 0; i < n && i < 4; i++) {
            putstr(0, (uint8_t)(2 + i), "0x");
            {
                char hx[4];
                sprintf(hx, "%02X", found[i]);
                putstr(12, (uint8_t)(2 + i), hx);
            }
            putstr(30, (uint8_t)(2 + i), dev_name(found[i]));
        }

        /* 状态行 */
        if (has_oled && has_max && has_mpu) {
            putstr(0, 7, "ALL 3 ONLINE  OK");
        } else {
            putstr(0, 7, "MISSING:");
            if (!has_oled) putstr(54, 7, "OLED");
            if (!has_max)  putstr(78, 7, "MAX");
            if (!has_mpu)  putstr(96, 7, "MPU");
        }
        oled_refresh();
        delay_ms(3500);

        /* ===== ★ 中文显示 ===== */
        printf("  OLED 显示中文「冻冻我想你了」... ");
        clear();
        /* 「冻冻」2个字 = 32列，居中放 x=48 */
        draw_cn(48, 0, "冻冻");
        /* 「我想你了」5个字 = 80列，居中放 x=24 */
        draw_cn(24, 3, "我想你了");
        /* 底部加个小装饰 */
        putstr(0, 7, "  *  STM32  *");
        fails = oled_refresh();
        printf("%s\r\n", fails ? "★ 失败" : "√");
        delay_ms(4500);

        /* ===== 中文 + 设备状态 ===== */
        printf("  中文 + 状态显示... ");
        clear();
        draw_cn(32, 0, "冻冻");
        draw_cn(16, 2, "我想你了");
        putstr(0, 5, "OLED:");
        putstr(36, 5, has_oled ? "OK" : "--");
        putstr(0, 6, "MAX :");
        putstr(36, 6, has_max ? "OK" : "--");
        putstr(66, 6, "MPU:");
        putstr(96, 6, has_mpu ? "OK" : "--");
        putstr(0, 7, "Err:");
        putnum(30, 7, (int32_t)g_err);
        fails = oled_refresh();
        printf("%s\r\n", fails ? "★ 失败" : "√");
        delay_ms(4500);

        round++;
        if (round > 999) round = 1;
    }
}
