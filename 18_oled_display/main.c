/**
 ******************************************************************************
 *  18_oled_display —— ★ OLED 综合显示测试（带 I2C 错误检测）
 ******************************************************************************
 *  目的：
 *      ① 让 OLED 显示各种内容（文字、数字、进度条、图案）
 *      ② ★ 检测 I2C 写入是否稳定（每次写都检查 ACK，失败就报错）
 *      ③ 诊断"亮一下就黑"的原因
 *
 *  它会循环做：
 *      阶段 1  全屏点亮（全白）      —— 证明屏幕能全亮
 *      阶段 2  全屏熄灭（全黑）
 *      阶段 3  显示 8 行文字
 *      阶段 4  计数器（数字每秒变）  —— 验证刷新正常
 *      阶段 5  进度条（左右增长）
 *      阶段 6  显示图案（边框 + 方块）
 *      阶段 7  回到阶段 1
 *
 *  ★ 每个阶段都会检查 I2C 是否写成功：
 *      成功 → 串口打印 OK
 *      失败 → 打印 ★ I2C 错误！并累计错误次数
 *
 *  ★ 接线：
 *      OLED GND → STM32【G】
 *      OLED VCC → STM32【3.3】
 *      OLED SCL → STM32【B6】
 *      OLED SDA → STM32【B7】
 *      ★ 两个 4.7kΩ：B6←→3.3、B7←→3.3
 *      USB-TTL：TXD→A10、RXD→A9、GND→G
 ******************************************************************************
 */
#include "bsp.h"
#include "i2c.h"

#define OLED_ADDR   0x3C
#define W           128
#define PAGES       8

/* 显存 */
static uint8_t gram[PAGES][W];

/* 统计 */
static uint32_t g_ok = 0;
static uint32_t g_err = 0;

/* ==================== 带错误检测的底层 ==================== */

/* 写命令，返回 0 = 成功 */
static uint8_t oled_cmd(uint8_t c)
{
    return i2c_write_regs(OLED_ADDR, 0x00, &c, 1);
}

/* 写数据，返回 0 = 成功 */
static uint8_t oled_data(const uint8_t *d, uint16_t len)
{
    return i2c_write_regs(OLED_ADDR, 0x40, d, len);
}

/* ★ 逐页刷新，检查每一页是否成功；返回失败页数 */
static uint8_t oled_refresh_checked(void)
{
    uint8_t page, fails = 0;

    for (page = 0; page < PAGES; page++) {
        if (oled_cmd((uint8_t)(0xB0 + page)) != I2C_OK) { fails++; continue; }
        if (oled_cmd(0x00) != I2C_OK) { fails++; continue; }
        if (oled_cmd(0x10) != I2C_OK) { fails++; continue; }
        if (oled_data(gram[page], W) != I2C_OK) { fails++; }
    }

    if (fails == 0) g_ok++;
    else            g_err += fails;

    return fails;
}

/* ==================== 6×8 字库（和 oled.c 一致） ==================== */
static const uint8_t F6x8[][6] = {
    {0x00,0x00,0x00,0x00,0x00,0x00},{0x00,0x00,0x5F,0x00,0x00,0x00},
    {0x00,0x07,0x00,0x07,0x00,0x00},{0x14,0x7F,0x14,0x7F,0x14,0x00},
    {0x24,0x2A,0x7F,0x2A,0x12,0x00},{0x23,0x13,0x08,0x64,0x62,0x00},
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    {0x08,0x08,0x2A,0x1C,0x08,0x00},
};

/* ==================== 显存操作 ==================== */

static void clear(void)
{
    memset(gram, 0, sizeof(gram));
}

static void putstr(uint8_t x, uint8_t page, const char *s)
{
    if (page >= PAGES) return;
    while (*s) {
        uint8_t ch = (uint8_t)(*s++);
        uint8_t i;
        if (ch < 0x20 || ch > 0x7E) ch = 0x20;
        if (x + 6 > W) break;
        for (i = 0; i < 6; i++) gram[page][x + i] = F6x8[ch - 0x20][i];
        x += 6;
    }
}

static void putnum(uint8_t x, uint8_t page, int32_t v)
{
    char b[16];
    sprintf(b, "%d", (int)v);
    putstr(x, page, b);
}

static void fill_byte(uint8_t v)
{
    memset(gram, v, sizeof(gram));
}

/* 画一个矩形边框 */
static void draw_frame(void)
{
    uint8_t p, i;
    for (p = 0; p < PAGES; p++) {
        gram[p][0] = 0xFF;
        gram[p][W - 1] = 0xFF;
    }
    gram[0][0] = 0xFF; gram[0][W-1] = 0xFF;
    for (i = 0; i < W; i++) { gram[0][i] = 0xFF; gram[PAGES-1][i] = 0xFF; }
}

/* 画进度条（第 page 页，宽度按 pct 0~100） */
static void draw_bar(uint8_t page, uint8_t pct)
{
    uint8_t i;
    uint16_t w = (uint16_t)((W - 4) * pct / 100);
    if (page >= PAGES) return;
    for (i = 0; i < W; i++) gram[page][i] = 0x00;
    gram[page][0] = 0xFF;
    for (i = 0; i < w; i++) gram[page][2 + i] = 0x18;   /* 中间两条线 = 实心条 */
}

/* ==================== 初始化 ==================== */

static uint8_t oled_init_seq(void)
{
    uint8_t fail = 0;
    static const uint8_t seq[] = {
        0xAE, 0x20, 0x10, 0xB0, 0xC8, 0x00, 0x10, 0x40,
        0x81, 0xFF, 0xA1, 0xA6, 0xA8, 0x3F, 0xA4, 0xD3,
        0x00, 0xD5, 0xF0, 0xD9, 0x22, 0xDA, 0x12, 0xDB,
        0x20, 0x8D, 0x14, 0xAF
    };
    uint8_t i;
    for (i = 0; i < sizeof(seq); i++) {
        if (oled_cmd(seq[i]) != I2C_OK) fail++;
        delay_ms(2);
    }
    return fail;
}

/* ==================== 主程序 ==================== */

int main(void)
{
    uint32_t round = 1;
    uint8_t  i;
    uint8_t  fails;

    bsp_init();
    uart1_init();
    i2c_init();

    printf("\r\n\r\n");
    printf("============================================\r\n");
    printf("  501 毕设 —— OLED 综合显示测试\r\n");
    printf("  （带 I2C 错误检测）\r\n");
    printf("============================================\r\n");
    printf("  接线：GND->G  VCC->3.3  SCL->B6  SDA->B7\r\n");
    printf("        ★ 两个 4.7kΩ：B6<->3.3、B7<->3.3\r\n");
    printf("============================================\r\n\r\n");

    /* ---- 探测 ---- */
    printf("【探测】");
    if (i2c_probe(OLED_ADDR) == I2C_OK) {
        printf(" 找到 OLED（0x3C）\r\n\r\n");
    } else {
        printf(" ★ 找不到 OLED！检查接线和上拉\r\n\r\n");
    }

    /* ---- 初始化 ---- */
    printf("【初始化】发 28 条命令... ");
    fails = oled_init_seq();
    printf("%s（失败 %u 条）\r\n\r\n", fails ? "★ 有失败" : "√ 全部成功", fails);

    delay_ms(300);

    while (1) {
        printf("\r\n██████████ 第 %u 轮 ██████████\r\n", (unsigned)round);
        printf("  （累计：刷新成功 %u 次，I2C 错误 %u 次）\r\n\r\n",
               (unsigned)g_ok, (unsigned)g_err);

        /* ===== 阶段 1：全屏点亮 ===== */
        printf("  【阶段 1】全屏点亮（应该整屏全白）... ");
        fill_byte(0xFF);
        fails = oled_refresh_checked();
        printf("%s\r\n", fails ? "★ 刷新有失败！" : "√");
        for (i = 0; i < 15; i++) { led_onboard(1); delay_ms(100); led_onboard(0); }
        led_onboard(0);

        /* ===== 阶段 2：全屏熄灭 ===== */
        printf("  【阶段 2】全屏熄灭（应该全黑）... ");
        fill_byte(0x00);
        fails = oled_refresh_checked();
        printf("%s\r\n", fails ? "★ 刷新有失败！" : "√");
        delay_ms(800);

        /* ===== 阶段 3：8 行文字 ===== */
        printf("  【阶段 3】显示 8 行文字... ");
        clear();
        putstr(0, 0, "501 Health Helper");
        putstr(0, 1, "OLED Display Test");
        putstr(0, 2, "Line 3: ABCDEFG");
        putstr(0, 3, "Line 4: 1234567890");
        putstr(0, 4, "Line 5: Hello STM32");
        putstr(0, 5, "Line 6: I2C = PB6/B7");
        putstr(0, 6, "Line 7: Addr = 0x3C");
        putstr(0, 7, "Line 8: All 8 lines!");
        fails = oled_refresh_checked();
        printf("%s\r\n", fails ? "★ 刷新有失败！" : "√");
        delay_ms(2500);

        /* ===== 阶段 4：计数器（验证刷新） ===== */
        printf("  【阶段 4】计数器（数字每秒变，看 10 秒）... ");
        clear();
        putstr(0, 0, "=== Counter Test ===");
        putstr(0, 2, "Count:");
        putstr(0, 4, "I2C errors:");
        fails = oled_refresh_checked();
        printf("%s\r\n", fails ? "★ 失败" : "√");

        for (i = 1; i <= 10; i++) {
            /* 只清数字那两行，其他不动 */
            memset(&gram[2][40], 0, 6 * 8);
            memset(&gram[4][66], 0, 6 * 6);
            putnum(40, 2, (int32_t)i);
            putnum(66, 4, (int32_t)g_err);
            oled_refresh_checked();
            printf("      计数 = %u\r\n", i);
            delay_ms(1000);
        }

        /* ===== 阶段 5：进度条 ===== */
        printf("  【阶段 5】进度条（0%% -> 100%% -> 0%%）... ");
        clear();
        putstr(0, 0, "Progress Bar Test");
        for (i = 0; i <= 100; i += 5) {
            draw_bar(4, i);
            memset(&gram[6][0], 0, 60);
            putnum(0, 6, (int32_t)i);
            putstr(30, 6, "%");
            oled_refresh_checked();
            delay_ms(60);
        }
        printf("√\r\n");
        delay_ms(600);

        /* ===== 阶段 6：图案 ===== */
        printf("  【阶段 6】边框图案... ");
        clear();
        draw_frame();
        putstr(14, 3, "** FRAME **");
        putstr(14, 4, "STM32 OLED");
        fails = oled_refresh_checked();
        printf("%s\r\n", fails ? "★ 失败" : "√");
        delay_ms(2500);

        /* ===== 阶段 7：结果统计 ===== */
        printf("  【阶段 7】显示统计结果... ");
        clear();
        putstr(0, 0, "=== RESULT ===");
        putstr(0, 2, "Refresh OK:");
        putnum(78, 2, (int32_t)g_ok);
        putstr(0, 4, "I2C errors:");
        putnum(78, 4, (int32_t)g_err);
        putstr(0, 6, g_err == 0 ? "STATUS: ALL GOOD" : "STATUS: HAS ERROR");
        fails = oled_refresh_checked();
        printf("%s\r\n", fails ? "★ 失败" : "√");
        delay_ms(3000);

        round++;
        if (round > 999) round = 1;
    }
}
